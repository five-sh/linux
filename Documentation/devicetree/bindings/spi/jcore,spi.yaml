## Documentation/devicetree/bindings/spi/jcore,spi.yaml
```yaml
# SPDX-License-Identifier: (GPL-2.0-only OR BSD-2-Clause)
%YAML 1.2
---

$id: http://devicetree.org/schemas/spi/jcore,spi.yaml#
$schema: http://devicetree.org/meta-schemas/core.yaml#

title: J-Core SPI controller

description:
  The J-Core "spi2" device is a PIO-based SPI controller which used to
  perform byte-at-a-time transfers between the CPU and itself.

maintainers:
  - Kousik Sanagavarapu <five231003@gmail.com>

allOf:
  - $ref: spi-controller.yaml#

properties:
  compatible:
    const: jcore,spi2

  reg:
    maxItems: 1

  clocks:
    maxItems: 1

  clock-names:
    items:
      - const: ref_clk

  spi-max-frequency:
    $ref: /schemas/types.yaml#/definitions/uint32

required:
  - compatible
  - reg

unevaluatedProperties: false

examples:
  - |
    spi@40 {
        compatible = "jcore,spi2";
        reg = <0x40 0x8>;
        #address-cells = <1>;
        #size-cells = <0>;
        spi-max-frequency = <25000000>;
        clocks = <&bus_clk>;
        clock-names = "ref_clk";
    };
```
